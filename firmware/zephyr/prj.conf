## CMakeLists.txt
```
# The bridge on Zephyr, for the nRF52840 boards. The shared sources are the ESP32 build's own,
# from ../src; what differs is the platform under them (src/port_zephyr.*), the Bluetooth host
# (src/ble_nus.c) and start-up (src/main.c). See docs/BUILDING.md.
cmake_minimum_required(VERSION 3.20.0)
find_package(Zephyr REQUIRED HINTS $ENV{ZEPHYR_BASE})
project(dmd2_lora_bridge)

set(SHARED ${CMAKE_CURRENT_SOURCE_DIR}/../src)

target_sources(app PRIVATE
    src/main.c
    src/port_zephyr.c
    src/ble_nus.c
    src/store.c
    ${SHARED}/bridge.c
    ${SHARED}/sx1262.c
    ${SHARED}/led.c
    ${SHARED}/cfg_parse.c
    ${SHARED}/wire_payload.c
    ${SHARED}/bench_cmd.c
)
target_include_directories(app PRIVATE src ${SHARED})
# The board's pins, from its devicetree, ahead of everything else in the app: sx1262.h's
# defaults are the Heltec's and apply to whatever has not been named first.
target_compile_options(app PRIVATE -include ${CMAKE_CURRENT_SOURCE_DIR}/src/board.h)
```

## prj.conf
```kconfig
# The bridge on an nRF52840: a Bluetooth peripheral that bonds, the SX1262 on SPI, and the
# board's own USB for logs and the bench - as an ESP32-S3 bridge uses its native USB.

CONFIG_GPIO=y
CONFIG_SPI=y
# The OLED, only to put it to sleep (main.c).
CONFIG_I2C=y

# Kernel objects the bridge makes at runtime - mutexes, queues, threads and their stacks - and
# the transmit queue's copy of each packet.
CONFIG_HEAP_MEM_POOL_SIZE=32768
CONFIG_DYNAMIC_THREAD=y
CONFIG_DYNAMIC_THREAD_ALLOC=y
CONFIG_DYNAMIC_THREAD_STACK_SIZE=4096
CONFIG_THREAD_NAME=y
CONFIG_MAIN_STACK_SIZE=4096
CONFIG_SYSTEM_WORKQUEUE_STACK_SIZE=4096
CONFIG_COMMON_LIBC_MALLOC_ARENA_SIZE=8192

# Why the board last started, restarting it, and the task watchdog.
CONFIG_HWINFO=y
CONFIG_REBOOT=y
CONFIG_TASK_WDT=y

# Settings - the bonds - on the partition the UF2 layout leaves for them.
CONFIG_FLASH=y
CONFIG_FLASH_MAP=y
CONFIG_NVS=y
CONFIG_SETTINGS=y
CONFIG_SETTINGS_NVS=y
# A record whose data was corrupted then fails its read rather than passing for another record;
# the bond store's own scan (store.c) counts on reads that fail saying so.
CONFIG_NVS_DATA_CRC=y

# Logs: deferred, with room to ride out a burst while the USB console catches up.
CONFIG_LOG=y
CONFIG_LOG_BUFFER_SIZE=8192

CONFIG_BT=y
CONFIG_BT_PERIPHERAL=y
CONFIG_BT_MAX_CONN=1
CONFIG_BT_MAX_PAIRED=2
CONFIG_BT_SMP=y
CONFIG_BT_SMP_APP_PAIRING_ACCEPT=y
CONFIG_BT_SETTINGS=y
CONFIG_BT_DEVICE_NAME_DYNAMIC=y
CONFIG_BT_DEVICE_NAME_MAX=30
CONFIG_BT_DEVICE_NAME="LoRaBridge-for-DMD2"
# The phone asks for a 247-byte MTU, and lines run to hundreds of characters.
CONFIG_BT_L2CAP_TX_MTU=247
CONFIG_BT_BUF_ACL_RX_SIZE=251
CONFIG_BT_BUF_ACL_TX_SIZE=251
CONFIG_BT_CTLR_DATA_LENGTH_MAX=251
CONFIG_BT_BUF_ACL_TX_COUNT=10
CONFIG_BT_BUF_EVT_RX_COUNT=16
CONFIG_BT_ATT_TX_COUNT=10
CONFIG_BT_L2CAP_TX_BUF_COUNT=10
# The phone's commands run on the host's receive thread, radio configuration included.
CONFIG_BT_RX_STACK_SIZE=4096
```

## app.overlay
```dts
/*
 * The USB console holds one 64-byte packet for a character write and, without flow control,
 * drops whatever does not fit: every log line past 64 bytes lost its tail, the bench's
 * "bridge up" among them. With it, a full packet makes the writer sleep 1 ms and retry. The only
 * writer is the deferred log thread (printk goes through the log), so the bridge never waits;
 * with no host reading, the log buffer overflows instead, and a panic's output, written from
 * the fault handler, is still dropped rather than waited for.
 *
 * ponytail: with no host, the log thread wakes every 1 ms for as long as USB stays unread;
 * turn flow control on only while DTR is set if the current-draw measurement shows it.
 */
&board_cdc_acm_uart {
	hw-flow-control;
};
```

## src/main.c
```c
/*
 * DMD2 LoRa bridge on Zephyr, for the nRF52840 boards: storage and the board, then the bridge
 * itself (bridge.c), which is the same on every board.
 */
#include "bridge.h"
#include "led.h"
#include "port.h"
#include "store.h"

#include <stdio.h>

#include <zephyr/kernel.h>
#include <zephyr/settings/settings.h>

#define TAG "bridge"

#ifdef BOARD_OLED_SH1106
#include <zephyr/drivers/i2c.h>

/* Display off, then its charge pump off; 0x00 says commands follow. Sent on the bus directly:
 * Zephyr's display driver ends its init by turning the panel on, old image and all. */
static void oled_off(void) {
    static const struct i2c_dt_spec oled = I2C_DT_SPEC_GET(BOARD_OLED_SH1106);
    static const uint8_t off[] = {0x00, 0xAE, 0xAD, 0x8A};
    if (!i2c_is_ready_dt(&oled) || i2c_write_dt(&oled, off, sizeof(off)) != 0) {
        LOGW(TAG, "display did not take the off command");
    }
}
#endif

int main(void) {
    const char *reset = bridge_reset_name();
    LOGI(TAG, "started after: %s", reset);
    /* Watched through the slow part of start-up as well, as on the ESP32 builds. */
    const int watch = port_wdt_watch();
    /* Before storage and the radio, so a board waiting on either still shows it is alive. */
    led_init();
#ifdef PIN_GNSS_STANDBY
    port_pin_output(PIN_GNSS_STANDBY);
    port_pin_set(PIN_GNSS_STANDBY, 0);
#endif
#ifdef BOARD_OLED_SH1106
    oled_off();
#endif

    /* Not this firmware's storage going bad, and no owner of ours in it to protect, so it is
     * cleared without asking. */
    if (store_holds_littlefs()) {
        LOGW(TAG, "storage holds another firmware's file system - clearing it");
        store_erase();
    }
    int err = settings_subsys_init();
    if (err != 0) {
        char why[24];
        snprintf(why, sizeof(why), "settings %d", err);
        bridge_erase_when_asked(why, watch, store_erase);
        err = settings_subsys_init();
        if (err != 0) {
            LOGE(TAG, "storage still will not open (%d)", err);
            k_panic();
        }
    }

    /*
     * The bonds, read before anything loads settings. Zephyr's loader deletes every entry whose
     * name it cannot read, so one load over an unreadable owner leaves a store with no owner at
     * all - and the next start, finding none, would let any phone claim the bridge. An unreadable
     * store is therefore left exactly as it is, so every start finds it unreadable again, and
     * Bluetooth stays off until the button erases it.
     */
    static struct store_bonds bonds;
    err = store_scan_bonds(&bonds);
    if (err != 0) {
        char why[32];
        snprintf(why, sizeof(why), "bond store unreadable, %d", err);
        bridge_erase_when_asked(why, watch, store_erase);
        /* Settings are still mounted over what was just erased: start again, not write into it. */
        port_restart(RESTART_NOTE_MAGIC | RESTART_FOR_BOND);
    }

    bridge_start(reset, watch);
    port_wdt_unwatch(watch);
    return 0;
}
```

## src/board.h
```c
#pragma once
/*
 * What sx1262.h, led.c and the bridge need to know about this board, read from its devicetree
 * rather than written down twice. Included ahead of every source of the app (see CMakeLists.txt),
 * because sx1262.h's defaults are the Heltec's and apply to whatever has not been named first.
 *
 * Pins are port * 32 + pin, the number port_zephyr.c takes apart again.
 */
#include <zephyr/devicetree.h>
#include <zephyr/dt-bindings/gpio/gpio.h>
#include <zephyr/dt-bindings/lora/sx126x.h>

#define BOARD_LORA DT_ALIAS(lora0)
#define BOARD_PSEL(node, prop) \
    (DT_PROP(DT_GPIO_CTLR(node, prop), port) * 32 + DT_GPIO_PIN(node, prop))

#if !DT_NODE_HAS_COMPAT(BOARD_LORA, semtech_sx1262)
#error "this build needs an SX1262 behind the board's lora0 alias"
#endif

#define RADIO_BACKEND_SX1262 1

/* The bus and its chip select come from the devicetree, which port_zephyr.c reads directly;
 * the numbers here are for the startup log only. */
#define PIN_SX_NSS                                                                   \
    (DT_PROP(DT_SPI_DEV_CS_GPIOS_CTLR(BOARD_LORA), port) * 32 +                      \
     DT_SPI_DEV_CS_GPIOS_PIN(BOARD_LORA))
#define PIN_SX_SCK  (-1)
#define PIN_SX_MOSI (-1)
#define PIN_SX_MISO (-1)

#define PIN_SX_RST  BOARD_PSEL(BOARD_LORA, reset_gpios)
#define PIN_SX_BUSY BOARD_PSEL(BOARD_LORA, busy_gpios)
#define PIN_SX_DIO1 BOARD_PSEL(BOARD_LORA, dio1_gpios)
#if DT_NODE_HAS_PROP(BOARD_LORA, rx_enable_gpios)
#define PIN_SX_RXEN BOARD_PSEL(BOARD_LORA, rx_enable_gpios)
#endif

/* No KCT8103L or anything like it: the chip's own output, as on the T-Deck. */
#define PIN_FEM_VCTRL (-1)

/* The driver sets both of these itself, so a board that wires them otherwise has to say so
 * here rather than be driven wrongly. */
#if !DT_PROP(BOARD_LORA, dio2_tx_enable)
#error "the SX1262 backend drives the antenna switch from DIO2"
#endif
#if DT_PROP(BOARD_LORA, dio3_tcxo_voltage) != SX126X_DIO3_TCXO_1V8
#error "the SX1262 backend powers the TCXO at 1.8 V from DIO3"
#endif
#define SX_TCXO_MV 1800

/* The indicator: led.c drives it high for on. */
#if DT_NODE_EXISTS(DT_ALIAS(led0))
#if DT_GPIO_FLAGS(DT_ALIAS(led0), gpios) & GPIO_ACTIVE_LOW
#error "led.c drives the indicator high for on"
#endif
#define PIN_LED BOARD_PSEL(DT_ALIAS(led0), gpios)
#endif

/* Read through port_button_down(), with the polarity and pull the devicetree gives it. */
#if !DT_NODE_EXISTS(DT_ALIAS(sw0))
#error "the bridge needs a button: hold it to forget the paired phone"
#endif

/*
 * Things a board carries that this firmware does not use and should keep from drawing current.
 * The L1's GNSS runs from power-up unless its standby line is pulled low - P1.09, from Seeed's
 * pin map (Meshtastic's variant); Zephyr's board file does not name it.
 */
#if DT_NODE_HAS_COMPAT(DT_ROOT, seeed_wio_tracker_l1)
#define PIN_GNSS_STANDBY (1 * 32 + 9)
#endif
/* Its OLED keeps lit whatever the last firmware drew - Meshtastic's welcome screen, after
 * Meshtastic - since a restart does not reset it. main.c puts it to sleep. */
#if DT_HAS_CHOSEN(zephyr_display) && DT_NODE_HAS_COMPAT(DT_CHOSEN(zephyr_display), sinowealth_sh1106)
#define BOARD_OLED_SH1106 DT_CHOSEN(zephyr_display)
#endif

/* As every ESP32 build: the phone may ask for any of the four levels. */
#ifndef MIN_POWER_INDEX
#define MIN_POWER_INDEX 0
#endif
```

## src/port_zephyr.c
```c
/* port.h on Zephyr: the parts that are more than a call through. */
#include "port.h"

#include <stdarg.h>
#include <stdio.h>
#include <string.h>

#include <zephyr/device.h>
#include <zephyr/drivers/gpio.h>
#include <zephyr/drivers/hwinfo.h>
#include <zephyr/drivers/spi.h>
#include <zephyr/drivers/uart.h>
#include <zephyr/fatal.h>
#include <zephyr/logging/log.h>
#include <zephyr/sys/reboot.h>
#include <zephyr/task_wdt/task_wdt.h>
#include <hal/nrf_power.h>

#define TAG "port"

/* ---- log ------------------------------------------------------------------ */

LOG_MODULE_REGISTER(app, LOG_LEVEL_INF);

/*
 * Through Zephyr's own log, deferred, so these lines and the host's never interleave and a
 * caller never waits on the USB console - which, with a terminal open and not reading, would
 * otherwise sleep inside a log call. The bench scripts look only at the text after the tag.
 */
void port_log(char level, const char *tag, const char *fmt, ...) {
    char text[200];
    va_list ap;
    va_start(ap, fmt);
    vsnprintf(text, sizeof(text), fmt, ap);
    va_end(ap);
    switch (level) {
        case 'E': LOG_ERR("%s: %s", tag, text); break;
        case 'W': LOG_WRN("%s: %s", tag, text); break;
        default: LOG_INF("%s: %s", tag, text); break;
    }
}

/* ---- kernel objects -------------------------------------------------------- */

port_mutex_t port_mutex_create(void) {
    struct k_mutex *m = k_malloc(sizeof(*m));
    if (!m) k_panic();
    k_mutex_init(m);
    return m;
}

port_queue_t port_queue_create(size_t count, size_t item_size) {
    struct k_msgq *q = k_malloc(sizeof(*q));
    char *ring = k_malloc(count * item_size);
    if (!q || !ring) k_panic();
    k_msgq_init(q, ring, item_size, count);
    return q;
}

struct task_start {
    void (*fn)(void *);
};

static void task_entry(void *start, void *unused1, void *unused2) {
    (void)unused1;
    (void)unused2;
    ((struct task_start *)start)->fn(NULL);
}

/*
 * The bridge's priorities are FreeRTOS's, counting up; Zephyr counts down, so 1..6 become 14..9,
 * all preemptible. The Bluetooth host's own threads are cooperative and run ahead of every one of
 * them, and its line output (ble_nus.c, 8) runs ahead of the radio's busy wait.
 */
bool port_task_create(void (*fn)(void *), const char *name, size_t stack, int prio) {
    struct k_thread *thread = k_malloc(sizeof(*thread));
    struct task_start *start = k_malloc(sizeof(*start));
    k_thread_stack_t *stack_mem = k_thread_stack_alloc(stack, 0);
    if (!thread || !start || !stack_mem) return false;
    start->fn = fn;
    k_tid_t tid = k_thread_create(thread, stack_mem, stack, task_entry, start, NULL, NULL,
                                  K_PRIO_PREEMPT(15 - prio), 0, K_NO_WAIT);
    k_thread_name_set(tid, name);
    return true;
}

/* ---- watchdog -------------------------------------------------------------- */

/* What the watchdog and a fatal error leave for the next start when they restart the board, so
 * that start can say task_wdt or panic, as an ESP32 does, rather than a plain sw. */
#define NOTE_TASK_WDT 0x5E70B001u
#define NOTE_PANIC 0x5E70B002u

static void wdt_expired(int channel, void *user_data) {
    (void)channel;
    (void)user_data;
    port_restart(NOTE_TASK_WDT);
}

/*
 * Kernel timers, with the chip's own watchdog under them (prj.conf: 20 s): the task watchdog
 * feeds it from a timer interrupt, so a hang with interrupts off still restarts the board, as
 * reset=wdt. Once started it cannot be stopped, and it runs on through a software restart;
 * the UF2 bootloader feeds it, so an update is not cut short (an L1 Pro sat 45 s in its drive
 * with it running, then took a new image).
 */
int port_wdt_watch(void) {
    static bool ready;
    if (!ready) {
        ready = task_wdt_init(DEVICE_DT_GET(DT_ALIAS(watchdog0))) == 0;
    }
    const int channel = ready ? task_wdt_add(30 * 1000, wdt_expired, NULL) : -1;
    if (channel < 0) LOGW(TAG, "task watchdog unavailable (%d)", channel);
    return channel;
}

void port_wdt_feed(int watch) {
    if (watch >= 0) task_wdt_feed(watch);
}

void port_wdt_unwatch(int watch) {
    if (watch >= 0) task_wdt_delete(watch);
}

/* ---- pins ------------------------------------------------------------------ */

static const struct device *const s_gpio[] = {
    DEVICE_DT_GET(DT_NODELABEL(gpio0)),
    DEVICE_DT_GET(DT_NODELABEL(gpio1)),
};

static const struct device *pin_port(int pin) { return s_gpio[pin / 32]; }

void port_pin_output(int pin) { gpio_pin_configure(pin_port(pin), pin % 32, GPIO_OUTPUT); }
void port_pin_input(int pin) { gpio_pin_configure(pin_port(pin), pin % 32, GPIO_INPUT); }
/* Raw: the level on the wire, as the ESP32 builds mean it, not the devicetree's active sense. */
void port_pin_set(int pin, int level) { gpio_pin_set_raw(pin_port(pin), pin % 32, level); }
int port_pin_get(int pin) { return gpio_pin_get_raw(pin_port(pin), pin % 32); }

static const struct gpio_dt_spec s_button = GPIO_DT_SPEC_GET(DT_ALIAS(sw0), gpios);

/* Logical, so the devicetree's polarity and pull apply; configured on first use. */
bool port_button_down(void) {
    static bool ready;
    if (!ready) {
        ready = gpio_pin_configure_dt(&s_button, GPIO_INPUT) == 0;
    }
    return ready && gpio_pin_get_dt(&s_button) == 1;
}

/* ---- the radio's bus -------------------------------------------------------- */

static struct spi_dt_spec s_spi =
    SPI_DT_SPEC_GET(DT_ALIAS(lora0), SPI_WORD_SET(8) | SPI_TRANSFER_MSB | SPI_OP_MODE_CONTROLLER);

/* The devicetree names the bus and the chip select; the clock is held at the ESP32 builds' 2 MHz,
 * so the two drivers time the chip alike. The pin arguments are theirs. */
void port_radio_spi_init(int nss, int sck, int mosi, int miso) {
    (void)nss;
    (void)sck;
    (void)mosi;
    (void)miso;
    if (!spi_is_ready_dt(&s_spi)) k_panic();
    s_spi.config.frequency = 2 * 1000 * 1000;
}

bool port_radio_spi_xfer(const uint8_t *tx, uint8_t *rx, size_t len) {
    const struct spi_buf tx_buf = {.buf = (void *)tx, .len = len};
    const struct spi_buf rx_buf = {.buf = rx, .len = len};
    const struct spi_buf_set txs = {.buffers = &tx_buf, .count = 1};
    const struct spi_buf_set rxs = {.buffers = &rx_buf, .count = 1};
    return spi_transceive_dt(&s_spi, &txs, &rxs) == 0;
}

/* ---- reset and restart -------------------------------------------------------- */

/*
 * Survives a software reset - RAM is not cleared - but not a power loss. Whether the UF2
 * bootloader, which runs on every reset, leaves this word alone is to be confirmed on the board;
 * if it does not, the cost is reset=sw where ble_stuck or bond_reset was meant.
 */
static __noinit uint32_t s_restart_note;

void port_restart(uint32_t note) {
    s_restart_note = note;
    sys_reboot(SYS_REBOOT_COLD);
}

/* Adafruit's UF2 bootloader, the one the L1 ships with, stays in its drive mode when it starts
 * with this in GPREGRET. Zephyr's sys_reboot() ignores its type on the nRF52, so it is set here. */
#define UF2_BOOTLOADER_MAGIC 0x57

void port_restart_to_bootloader(void) {
    nrf_power_gpregret_set(NRF_POWER, 0, UF2_BOOTLOADER_MAGIC);
    sys_reboot(SYS_REBOOT_COLD);
}

/*
 * In place of Zephyr's, which halts: a halted bridge is off the air until someone re-plugs it,
 * and the kernel's watchdog, the only one running, halts with it. A restart is back in seconds.
 */
void k_sys_fatal_error_handler(unsigned int reason, const struct arch_esf *esf) {
    (void)reason;
    (void)esf;
    port_restart(NOTE_PANIC);
}

/* Read once, then cleared, so a note never outlives the restart it was left for. */
static uint32_t note_once(void) {
    static bool read;
    static uint32_t note;
    if (!read) {
        read = true;
        note = s_restart_note;
        s_restart_note = 0;
    }
    return note;
}

uint32_t port_restart_note(void) { return note_once(); }

/* The nRF52's reset reasons, in ESP-IDF's words where there is one. A brownout looks like a
 * power-on here: the chip keeps no separate flag for it. */
const char *port_reset_cause(void) {
    static const char *cause;
    if (cause) return cause;
    uint32_t flags = 0;
    if (hwinfo_get_reset_cause(&flags) != 0) flags = 0;
    (void)hwinfo_clear_reset_cause();   /* they accumulate across resets until cleared */
    if (flags & RESET_WATCHDOG) {
        cause = "wdt";
    } else if (flags & RESET_CPU_LOCKUP) {
        cause = "panic";
    } else if (flags & RESET_SOFTWARE) {
        const uint32_t note = note_once();
        cause = note == NOTE_TASK_WDT ? "task_wdt" : note == NOTE_PANIC ? "panic" : "sw";
    } else if (flags & RESET_PIN) {
        cause = "pin";
    } else if (flags == 0) {
        cause = "poweron";
    } else {
        cause = "other";
    }
    return cause;
}

/* ---- the bench's console --------------------------------------------------- */

static const struct device *const s_console = DEVICE_DT_GET(DT_CHOSEN(zephyr_console));

void port_console_open(void) {}

/* The console is the board's own USB, as on an ESP32-S3; polled, since only the bench reads it. */
int port_console_getc(uint32_t timeout_ms) {
    const int64_t until = k_uptime_get() + timeout_ms;
    do {
        unsigned char c;
        if (uart_poll_in(s_console, &c) == 0) return c;
        k_msleep(10);
    } while (k_uptime_get() < until);
    return -1;
}
```

## src/port_zephyr.h
```c
#pragma once
/*
 * port.h on Zephyr, for the nRF52840 boards: the kernel's clock, mutexes, queues and threads;
 * pins as port * 32 + pin; the radio's bus and chip select from the board's devicetree.
 */
#include <stdbool.h>
#include <stddef.h>
#include <stdint.h>

#include <zephyr/kernel.h>

void port_log(char level, const char *tag, const char *fmt, ...)
    __attribute__((format(printf, 3, 4)));
#define LOGI(tag, ...) port_log('I', tag, __VA_ARGS__)
#define LOGW(tag, ...) port_log('W', tag, __VA_ARGS__)
#define LOGE(tag, ...) port_log('E', tag, __VA_ARGS__)

static inline int64_t port_uptime_us(void) {
    return (int64_t)k_ticks_to_us_floor64((uint64_t)k_uptime_ticks());
}
static inline void port_delay_us(uint32_t us) { k_busy_wait(us); }
static inline void port_sleep_ms(uint32_t ms) { k_msleep((int32_t)ms); }
static inline void port_yield(void) { k_yield(); }

typedef struct k_mutex *port_mutex_t;
port_mutex_t port_mutex_create(void);
static inline bool port_mutex_take(port_mutex_t m, uint32_t timeout_ms) {
    return k_mutex_lock(m, K_MSEC(timeout_ms)) == 0;
}
static inline void port_mutex_lock(port_mutex_t m) { (void)k_mutex_lock(m, K_FOREVER); }
static inline void port_mutex_give(port_mutex_t m) { (void)k_mutex_unlock(m); }

typedef struct k_msgq *port_queue_t;
port_queue_t port_queue_create(size_t count, size_t item_size);
static inline bool port_queue_send(port_queue_t q, const void *item) {
    return k_msgq_put(q, item, K_NO_WAIT) == 0;
}
static inline bool port_queue_receive(port_queue_t q, void *item, uint32_t timeout_ms) {
    return k_msgq_get(q, item, K_MSEC(timeout_ms)) == 0;
}

bool port_task_create(void (*fn)(void *), const char *name, size_t stack, int prio);

int port_wdt_watch(void);
void port_wdt_feed(int watch);
void port_wdt_unwatch(int watch);

void port_pin_output(int pin);
void port_pin_input(int pin);
void port_pin_set(int pin, int level);
int port_pin_get(int pin);
bool port_button_down(void);

void port_radio_spi_init(int nss, int sck, int mosi, int miso);
bool port_radio_spi_xfer(const uint8_t *tx, uint8_t *rx, size_t len);

void port_restart(uint32_t note);
uint32_t port_restart_note(void);
const char *port_reset_cause(void);

void port_console_open(void);
int port_console_getc(uint32_t timeout_ms);

/* Opening the console does not restart this board - its USB would go with it - so every build
 * reads the console for the bench's BANNER request (bridge.c). */
#define PORT_CONSOLE_NO_RESET 1
```

## src/store.c
```c
#include "store.h"

#include <errno.h>
#include <string.h>

#include <settings/settings_nvs.h>
#include <zephyr/kernel.h>
#include <zephyr/storage/flash_map.h>

#define STORAGE PARTITION_ID(storage_partition)

void store_erase(void) {
    const struct flash_area *fa;
    if (flash_area_open(STORAGE, &fa) != 0 || flash_area_erase(fa, 0, fa->fa_size) != 0) {
        k_panic();
    }
    flash_area_close(fa);
}

/*
 * A board that ran Meshtastic or MeshCore - the L1 leaves the factory with one of them - keeps
 * their file system where this firmware keeps its settings: the Adafruit core's LittleFS, in the
 * last 28 kB below the bootloader. Its superblock carries the magic "littlefs" near the start of
 * a 4 kB block.
 */
bool store_holds_littlefs(void) {
    const struct flash_area *fa;
    if (flash_area_open(STORAGE, &fa) != 0) return false;
    bool found = false;
    for (size_t at = 0; !found && at + 256 <= fa->fa_size; at += 4096) {
        char head[256];
        if (flash_area_read(fa, (off_t)at, head, sizeof(head)) != 0) break;
        for (size_t i = 0; !found && i + 8 <= sizeof(head); i++) {
            found = memcmp(head + i, "littlefs", 8) == 0;
        }
    }
    flash_area_close(fa);
    return found;
}

/* What a bond leaves in settings: its keys, and what the GATT server keeps for that phone. */
static const char *const BOND_SUBTREES[] = {"bt/keys/", "bt/ccc/", "bt/sc/", "bt/cf/"};

static bool bond_record(const char *name) {
    for (size_t i = 0; i < ARRAY_SIZE(BOND_SUBTREES); i++) {
        if (strncmp(name, BOND_SUBTREES[i], strlen(BOND_SUBTREES[i])) == 0) return true;
    }
    return false;
}

/*
 * Straight from NVS, past the settings layer, which ownership cannot rest on: its loader reports
 * success whatever happened, and takes a read that failed for a half-written entry and deletes
 * it. NVS itself keeps the two apart - -ENOENT only for an entry that is not there - so here a
 * store that cannot be read is reported as one, never as an empty one.
 *
 * The layout is the settings NVS backend's (settings_nvs.h): names from NVS_NAMECNT_ID + 1 up to
 * the count kept at NVS_NAMECNT_ID, each value NVS_NAME_ID_OFFSET above its name. A name whose
 * value is missing is a write cut short, which the host's loader also skips.
 */
int store_scan_bonds(struct store_bonds *out) {
    memset(out, 0, sizeof(*out));
    void *storage = NULL;
    int rc = settings_storage_get(&storage);
    if (rc != 0 || storage == NULL) return rc != 0 ? rc : -ENODEV;
    struct nvs_fs *fs = storage;

    uint16_t last = 0;
    ssize_t n = nvs_read(fs, NVS_NAMECNT_ID, &last, sizeof(last));
    if (n == -ENOENT) return 0;   /* nothing was ever saved */
    if (n != (ssize_t)sizeof(last)) return n < 0 ? (int)n : -EIO;
    if (last >= NVS_NAMECNT_ID + NVS_NAME_ID_OFFSET) return -EIO;

    for (uint32_t id = NVS_NAMECNT_ID + 1; id <= last; id++) {
        char name[SETTINGS_FULL_NAME_LEN];
        n = nvs_read(fs, (uint16_t)id, name, sizeof(name) - 1);
        if (n == -ENOENT) continue;
        if (n < 0) return (int)n;
        name[MIN((size_t)n, sizeof(name) - 1)] = '\0';
        if (!bond_record(name)) continue;

        /* Read whole, so that with CONFIG_NVS_DATA_CRC a corrupted record fails here. */
        uint8_t value[256];
        n = nvs_read(fs, (uint16_t)(id + NVS_NAME_ID_OFFSET), value, sizeof(value));
        if (n == -ENOENT) continue;
        if (n < 0) return (int)n;
        if (out->count == STORE_RECORDS_MAX) return -ENOSPC;
        strcpy(out->names[out->count++], name);
        if (strncmp(name, "bt/keys/", 8) == 0) out->owners++;
    }
    return 0;
}

/*
 * Zephyr's loader deletes every entry whose name it cannot read, whatever subtree was asked for.
 * Run over an unreadable owner it would leave a store with no owner - read as such on this start
 * and every one after - so it runs only once the store has been read whole.
 */
int store_load_bonds(struct store_bonds *out, int *load_err) {
    *load_err = 0;
    const int rc = store_scan_bonds(out);
    if (rc != 0) return rc;
    *load_err = settings_load_subtree("bt");
    return 0;
}
```

## src/store.h
```c
#pragma once
/*
 * The settings partition, which holds the bonds: erasing it, recognising another firmware's file
 * system in it, and reading the bond records back with every read error kept.
 */
#include <stdbool.h>

#include <zephyr/settings/settings.h>

void store_erase(void);
bool store_holds_littlefs(void);

#define STORE_RECORDS_MAX 16

struct store_bonds {
    int owners;   /* complete bt/keys records: one per bonded phone */
    int count;    /* every record a bond keeps, keys and the rest, named below */
    char names[STORE_RECORDS_MAX][SETTINGS_FULL_NAME_LEN];
};

/* 0 with *out filled, or a negative errno when anything could not be read - or there were more
 * records than fit, which is no more knowable. Never "empty" for a store it could not read. */
int store_scan_bonds(struct store_bonds *out);

/* The host's settings - its identity and the bonds - loaded only over a store store_scan_bonds
 * read whole. Returns the scan's result, and with an error nothing was loaded; what the load
 * itself returned comes back in *load_err. */
int store_load_bonds(struct store_bonds *out, int *load_err);
```
